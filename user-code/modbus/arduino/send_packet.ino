/*........................crc function.......................*/

static unsigned char auchCRCHi[] = {0x00, 0xC1, 0x81, 0x40, 0x01, 0xC0, 0x80, 0x41, 0x01, 0xC0, 0x80, 0x41, 0x00, 0xC1, 0x81,
0x40, 0x01, 0xC0, 0x80, 0x41, 0x00, 0xC1, 0x81, 0x40, 0x00, 0xC1, 0x81, 0x40, 0x01, 0xC0,
0x80, 0x41, 0x01, 0xC0, 0x80, 0x41, 0x00, 0xC1, 0x81, 0x40, 0x00, 0xC1, 0x81, 0x40, 0x01,
0xC0, 0x80, 0x41, 0x00, 0xC1, 0x81, 0x40, 0x01, 0xC0, 0x80, 0x41, 0x01, 0xC0, 0x80, 0x41,
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0x00, 0xC1, 0x81, 0x40, 0x01, 0xC0, 0x80, 0x41, 0x01, 0xC0, 0x80, 0x41, 0x00, 0xC1, 0x81,
0x40
} ;

static char auchCRCLo[] = {
0x00, 0xC0, 0xC1, 0x01, 0xC3, 0x03, 0x02, 0xC2, 0xC6, 0x06, 0x07, 0xC7, 0x05, 0xC5, 0xC4,
0x04, 0xCC, 0x0C, 0x0D, 0xCD, 0x0F, 0xCF, 0xCE, 0x0E, 0x0A, 0xCA, 0xCB, 0x0B, 0xC9, 0x09,
0x08, 0xC8, 0xD8, 0x18, 0x19, 0xD9, 0x1B, 0xDB, 0xDA, 0x1A, 0x1E, 0xDE, 0xDF, 0x1F, 0xDD,
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0x44, 0x84, 0x85, 0x45, 0x87, 0x47, 0x46, 0x86, 0x82, 0x42, 0x43, 0x83, 0x41, 0x81, 0x80,
0x40
} ;

unsigned char crcval[8];
unsigned char crcval1[9];
unsigned char crcval2[6];

//crc function begins
unsigned short CRC16 ( unsigned char *puchMsg, unsigned short usDataLen, int hl)
{
unsigned char uchCRCHi = 0xff;
unsigned char uchCRCLo = 0xff;
unsigned int uIndex;
while(usDataLen--)
{
  uIndex = uchCRCLo ^ *puchMsg++;
  uchCRCLo = uchCRCHi ^ auchCRCHi[uIndex];
  uchCRCHi = auchCRCLo[uIndex];
  
}
if (hl==1)
return (uchCRCHi);//<<8 ;
else
return(uchCRCLo);
}

/*..................crc ends....................*/

/*-----( Import needed libraries )-----*/
#include <SoftwareSerial.h>
/*-----( Declare Constants and Pin Numbers )-----*/
#define SSerialRX        10  //Serial Receive pin
#define SSerialTX        11  //Serial Transmit pin

#define SSerialTxControl 3   //RS485 Direction control

#define RS485Transmit    HIGH
#define RS485Receive     LOW

#define Pin13LED         13

/*-----( Declare objects )-----*/
SoftwareSerial RS485Serial(SSerialRX, SSerialTX); // RX, TX

/*-----( Declare Variables )-----*/
int i,j,t,t1,t2;
uint8_t byteReceived[8];
uint8_t byteSend[8];
//uint8_t byteReceivedold;
uint8_t byteReceived1=5;
unsigned short CRC16 ( unsigned char * puchMsg, unsigned short usDataLen, int hl );
uint8_t res[2];

uint8_t byteReceived1_a[11]; 
uint8_t byteReceived1_d[7]; 


void setup()   /****** SETUP: RUNS ONCE ******/
{ 
   i=0;
   t=0;
   t1=0;
   t2=0;
  // Start the built-in serial port, probably to Serial Monitor
  Serial.begin(9600);
  
  pinMode(Pin13LED, OUTPUT);   
  pinMode(SSerialTxControl, OUTPUT);    
  
  digitalWrite(SSerialTxControl, RS485Receive);  // Init Transceiver   
  
  // Start the software serial port, to another device
  RS485Serial.begin(9600);   // set the data rate 

}//--(end setup )---


void loop()   /****** LOOP: RUNS CONSTANTLY ******/
{
  digitalWrite(Pin13LED, HIGH);  // Show activity
  while(Serial.available()>0)
  {
    byteReceived[i++]= Serial.read();
    //byteReceived=Serial.readBytesUntil('1',byteReceivedold,7);
     if(i==8) 
    { 
       for(j=0;j<8;++j)
       crcval[j]=byteReceived[j];
       res[0] = CRC16 (crcval,8,0);
       res[1]= CRC16 (crcval,8,1);    
       if (res[0]==0 && res[1]==0)
       {
        digitalWrite(SSerialTxControl, RS485Transmit);  // Enable RS485 Transmit 
         
        RS485Serial.write(byteReceived[0]);          // Send byte to Remote Arduino
        RS485Serial.write(byteReceived[1]); 
        RS485Serial.write(byteReceived[2]); 
        RS485Serial.write(byteReceived[3]); 
        RS485Serial.write(byteReceived[4]); 
        RS485Serial.write(byteReceived[5]); 
        RS485Serial.write(byteReceived[6]); 
        RS485Serial.write(byteReceived[7]); 
        i=0;
        }
        }   
    
        digitalWrite(Pin13LED, LOW);  // Show activity    
        //delay(10);
        digitalWrite(SSerialTxControl, RS485Receive);  // Disable RS485 Transmit       
      }
  
      
      if(byteReceived[1]==3)
      {
      if (RS485Serial.available())  //Look for data from other Arduino
       {
          byteReceived1_a[t1++] = RS485Serial.read();   
          
          if(t1==11)
          { 
            for(j=1;j<10;j++)
            crcval1[j-1]=byteReceived1_a[j];
            res[0]= CRC16 (crcval1,9,0);
            res[1]= CRC16 (crcval1,9,1);    
            if (res[0]==0 && res[1]==0)
            {
            Serial.write(byteReceived1_a[0]);
            Serial.write(byteReceived1_a[1]);
            Serial.write(byteReceived1_a[2]);
            Serial.write(byteReceived1_a[3]);
            Serial.write(byteReceived1_a[4]);
            Serial.write(byteReceived1_a[5]);
            Serial.write(byteReceived1_a[6]);
            Serial.write(byteReceived1_a[7]);
            Serial.write(byteReceived1_a[8]);
            Serial.write(byteReceived1_a[9]);
            Serial.write(byteReceived1_a[10]);
            t1=0;
            }
          }
        }
      }
      
      else if(byteReceived[1]==1)
      {
        if (RS485Serial.available())  //Look for data from other Arduino
         {
          byteReceived1_d[t2++] = RS485Serial.read();    // Read received byte 
          if(t2==7)
          {            
            for(j=0;j<6;++j)
            crcval2[j]=byteReceived1_d[j];
            res[0] = CRC16 (crcval2,6,0);
            res[1]= CRC16 (crcval2,6,1);    
            if (res[0]==0 && res[1]==0)
            {            
            Serial.write(byteReceived1_d[0]);
            Serial.write(byteReceived1_d[1]);
            Serial.write(byteReceived1_d[2]);
            Serial.write(byteReceived1_d[3]);
            Serial.write(byteReceived1_d[4]);
            Serial.write(byteReceived1_d[5]);
            Serial.write(byteReceived1_d[6]);
            t2=0;
            }
          digitalWrite(Pin13LED, LOW);  // Show activity   
         }          
        }
      }


}//--(end main loop )---

//*********( THE END )***********
